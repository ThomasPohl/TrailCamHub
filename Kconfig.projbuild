## components/hub_battery/Kconfig
```kconfig
menu "TrailCamHub: hub battery"

config HUB_BATTERY_MAX17048
    bool "Measure the hub battery with a MAX17048 fuel gauge"
    default y if IDF_TARGET_ESP32S3 && !BOARD_TDONGLE_S3 && !BOARD_S3_ETH
    default n
    help
        Read the hub's battery from a MAX17048 fuel gauge on I2C, as on the
        Waveshare ESP32-S3-A7670E-4G. The level is sent in the check-in
        (hubBatPercent), shown by the console's status command and written
        to the memory log. Without a cell the gauge has no power and the
        level stays unknown. Boards without a gauge leave this off.

config HUB_BATTERY_I2C_SDA_GPIO
    int "I2C SDA GPIO of the gauge"
    depends on HUB_BATTERY_MAX17048
    default 15

config HUB_BATTERY_I2C_SCL_GPIO
    int "I2C SCL GPIO of the gauge"
    depends on HUB_BATTERY_MAX17048
    default 16

config HUB_BATTERY_PERCENT_FROM_VOLTAGE
    bool "Compute the percentage from the cell voltage"
    depends on HUB_BATTERY_MAX17048
    default n
    help
        Report a percentage from the cell voltage along a typical Li-ion
        curve between the empty and the full voltage below, instead of the
        gauge's own state of charge. The gauge's estimate is usually better
        (it is less affected by load peaks of the modem), but it needs some
        time to settle after the cell was inserted.

config HUB_BATTERY_EMPTY_MV
    int "Empty cell voltage (mV)"
    depends on HUB_BATTERY_PERCENT_FROM_VOLTAGE
    range 2500 4000
    default 3300

config HUB_BATTERY_FULL_MV
    int "Full cell voltage (mV)"
    depends on HUB_BATTERY_PERCENT_FROM_VOLTAGE
    range 3500 4500
    default 4200

config HUB_BATTERY_LOW_PERCENT
    int "Low level: below this percentage (0 = off)"
    depends on HUB_BATTERY_MAX17048
    range 0 100
    default 30
    help
        In the low level the camera reads and the check-ins are stretched
        (factors below), not while the cell is being charged. The level is
        left only HUB_BATTERY_HYSTERESIS_PERCENT above the threshold. See
        docs/power-and-schedule.md.

config HUB_BATTERY_LOW_CAMERA_FACTOR
    int "Low level: camera read interval factor"
    depends on HUB_BATTERY_MAX17048
    range 1 16
    default 3

config HUB_BATTERY_LOW_CHECKIN_FACTOR
    int "Low level: check-in interval factor"
    depends on HUB_BATTERY_MAX17048
    range 1 16
    default 2

config HUB_BATTERY_CRITICAL_PERCENT
    int "Critical level: below this percentage (0 = off)"
    depends on HUB_BATTERY_MAX17048
    range 0 100
    default 10
    help
        In the critical level the hub reads no camera (not even one asked
        for by the backend) and only checks in, at the interval below, so
        that it keeps reporting its battery. It applies also while the
        cell is being charged.

config HUB_BATTERY_CRITICAL_MV
    int "Critical level: below this cell voltage (mV, 0 = off)"
    depends on HUB_BATTERY_MAX17048
    range 0 4200
    default 3500
    help
        The level is left 50 mV above this voltage.

config HUB_BATTERY_CRITICAL_CHECKIN_MIN
    int "Critical level: check-in interval (minutes)"
    depends on HUB_BATTERY_MAX17048
    range 30 1440
    default 720

config HUB_BATTERY_HYSTERESIS_PERCENT
    int "Leave a level this many percent above its threshold"
    depends on HUB_BATTERY_MAX17048
    range 0 50
    default 5

config HUB_BATTERY_MODEM_MIN_MV
    int "Lowest cell voltage to switch the modem on (mV, 0 = no limit)"
    depends on HUB_BATTERY_MAX17048
    range 0 4200
    default 3400
    help
        The A7670E draws current peaks of up to ~2 A while it transmits; on
        a nearly empty cell they can cause a brownout and a reset loop.
        Below this voltage a sync over the modem is not started (it counts
        as a failed sync). It lies below the critical level on purpose, so
        that a hub in that level can still report it.

endmenu
```

## components/hub_console/Kconfig
```kconfig
menu "TrailCamHub: serial console"

config HUB_CONSOLE_DIAGNOSTICS
    bool "Diagnostic commands (heap, ls, cat, rm, sdbench)"
    default y
    help
        Add commands to the serial console that show the internal RAM by
        capability and region, and list, read (as Base64 lines) and delete
        the files on the SD card and measure its write rate, so that a test
        run can be driven from a computer without taking out the card.
        tools/dongle_console.py runs commands and copies files. Files are
        not deleted while a scan uses the card.

endmenu
```

## components/modem_uplink/Kconfig
```kconfig
menu "TrailCamHub: modem uplink"

config MODEM_UPLINK
    bool "Sync with the backend over the A7670E cellular modem"
    depends on IDF_TARGET_ESP32S3 && !BOARD_TDONGLE_S3 && !BOARD_S3_ETH
    default y
    help
        Drive the A7670E LTE modem of the Waveshare ESP32-S3-A7670E-4G on
        the S3's native USB port (USB host, PPP). It is switched on for a
        backend sync and off again afterwards. Which transport a hub uses is a
        setting ("config set transport wifi|modem"); without one the modem is
        used when no home Wi-Fi is set. The APN and the SIM PIN are settings
        too. On the board the USB DIP switch must be OFF (modem on the S3).
        See docs/modem.md.

config MODEM_POWER_GPIO
    int "GPIO that switches the modem's power (-1: DIP switch)"
    depends on MODEM_UPLINK
    range -1 48
    default -1
    help
        High switches the modem on. With -1 the modem's power comes from the
        4G DIP switch (ON): it stays powered and is put into flight mode
        (AT+CFUN=4) between syncs. Waveshare names GPIO33 for boards where
        the 4G DIP switch is OFF; check the board revision, GPIO33-37 are
        taken by the octal PSRAM of the ESP32-S3R8.

config MODEM_ATTACH_TIMEOUT_S
    int "Time allowed to get online over the modem (seconds)"
    depends on MODEM_UPLINK
    range 30 600
    default 120
    help
        From switching the modem on to an IP address: the modem starts,
        the SIM card is unlocked, the modem registers with the network and
        the data call is made. Without a home Wi-Fi this replaces the
        Wi-Fi join timeout of the uplink.

endmenu
```

## components/ota_update/Kconfig
```kconfig
menu "TrailCamHub: firmware updates"

config OTA_AUTO_UPDATE
    bool "Install newer releases from GitHub"
    default y
    help
        After a successful sync the hub reads the manifest of the newest
        GitHub release (tag vX.Y.Z) at most once a day. A hub that runs an
        older release downloads the image for its board and build variant
        over HTTPS into the other OTA slot, checks its size, SHA-256 and
        version, and restarts into it once the cycle is over. The new
        firmware is kept once a check-in succeeds; a restart before that
        goes back to the old one, and that version is not installed again
        automatically. Development builds (a commit hash as version) are
        never replaced. See docs/ota.md.

config OTA_MANIFEST_URL
    string "Manifest of the latest release"
    depends on OTA_AUTO_UPDATE
    default "https://github.com/ThomasPohl/TrailCamHub/releases/latest/download/ota.json"
    help
        ota.json of GitHub's "latest release" (written by the CI for every
        vX.Y.Z tag; pre-releases are skipped). A fork can point to its own
        releases.

config OTA_CHECK_INTERVAL_H
    int "Read the manifest at most every (hours)"
    depends on OTA_AUTO_UPDATE
    range 1 168
    default 24
    help
        One read costs roughly 10-20 KB (TLS and GitHub's redirect), which
        counts over the cellular modem. The console command "update" reads
        it at the next sync regardless.

config OTA_MIN_BATTERY_PERCENT
    int "Install only at or above this hub battery (%)"
    depends on OTA_AUTO_UPDATE
    range 0 100
    default 40
    help
        Unless the cell is being charged. Never in the low or critical
        level of the schedule (HUB_BATTERY_LOW_PERCENT and
        HUB_BATTERY_CRITICAL_PERCENT); without a battery measurement there
        is no limit.

config OTA_MODEM_MIN_SIGNAL_DBM
    int "Over the modem: install only at or above this signal (dBm)"
    depends on OTA_AUTO_UPDATE
    range -113 -51
    default -105
    help
        A weak signal makes a download of 1.5-2 MB slow and likely to
        break off.

config OTA_MAX_ATTEMPTS
    int "Failed installs of one version before waiting"
    depends on OTA_AUTO_UPDATE
    range 1 20
    default 3

config OTA_RETRY_AFTER_H
    int "Then wait this long before the next attempt (hours)"
    depends on OTA_AUTO_UPDATE
    range 1 168
    default 24

config HUB_BOARD_ID
    string "Board name of the firmware images"
    default "tdongle-s3" if BOARD_TDONGLE_S3
    default "tdongle-c5" if BOARD_TDONGLE_C5
    default "esp32p4" if IDF_TARGET_ESP32P4
    default "s3-eth" if BOARD_S3_ETH
    default "wroom32d" if BOARD_ESP32_WROOM32D
    default "esp32s3"
    help
        Names the image of a release that fits this board (the board names
        of the CI build matrix).

config HUB_BUILD_VARIANT
    string "Build variant of the firmware images"
    default "dev"
    help
        "dev" (INFO logging) or "release" (size-optimized, warnings only;
        set by sdkconfig.defaults.release). An update keeps the variant.

endmenu
```

## components/schedule_state/Kconfig
```kconfig
menu "TrailCamHub: schedule"

config SCHEDULE_CAMERA_PLAN
    string "Camera read plan"
    default "*=120"
    help
        Applies on battery power, or when the hub pushes to a configured
        destination; otherwise (mains, nothing to push to) there are no
        automatic reads unless camera_plan is set.
        When the hub reads the cameras on its own: time windows in local time
        (TIME_ZONE), each with an interval in minutes, and "*" for the rest
        of the day, for example
          05:00-09:00=30,17:00-22:00=30,*=120
        reads every 30 minutes at dawn and dusk and every two hours
        otherwise. An interval of 0 means no reads; an empty plan or "off"
        means no automatic reads at all. The first window that contains a
        time applies. Without a valid clock the windows are ignored and the
        "*" interval applies (if it is 0 or missing, the longest window
        interval). Each read wakes the camera's Wi-Fi for a minute or two,
        which costs its battery. A read is followed by a backend sync if the
        uplink is configured.
        Overridden by "config set camera_plan" (serial console, web
        installer) and by the backend.

config SCHEDULE_CHECKIN_INTERVAL_MIN
    int "Backend check-in interval (minutes, 0 = off)"
    range 0 1440
    default 30
    help
        Applies when the hub pushes (direction push); with pull there are no
        check-ins.
        How often the hub syncs with the backend between camera reads, to
        pick up commands from the app (for example a camera read on
        request) and upload what is left. Only with complete uplink
        settings; every camera read syncs as well and restarts the
        interval. Overridden by "config set checkin_min" and by the
        backend.

config SCHEDULE_START_DELAY_S
    int "Delay before the first scheduled cycle after power-on (seconds)"
    range 0 3600
    default 60
    help
        Gives the web installer and the serial console time before the
        first automatic camera read or check-in after a power-on or reset.
        Not applied after a wake-up from deep sleep.

config SCHEDULE_LOW_BATTERY_PERCENT
    int "Camera battery level that stretches the read interval (%, 0 = off)"
    range 0 100
    default 20

config SCHEDULE_LOW_BATTERY_FACTOR
    int "Read interval factor for a camera with a low battery"
    range 1 16
    default 3
    help
        Failed reads stretch the interval as well (2, 4, 8, 16 times after
        one to four failures in a row), and failed check-ins stretch the
        check-in interval in the same way, up to one day.

endmenu
```

## components/scheduler/Kconfig
```kconfig
menu "TrailCamHub: power"

config POWER_DEEP_SLEEP
    bool "Deep sleep between cycles on battery power"
    default n if IDF_TARGET_ESP32P4
    default y
    help
        Builds the deep sleep in; it is used only while the mode's power is
        "battery" (setting "power", or the preset). Off on the ESP32-P4-NANO,
        whose Wi-Fi co-processor is not set up for it.
        When nothing is due for at least POWER_MIN_SLEEP_S seconds, the hub
        goes into deep sleep until the next camera read or check-in. While
        it sleeps the serial console, a web UI and the display do not
        respond; press the reset button to wake it for
        POWER_AWAKE_AFTER_BOOT_MIN minutes.

config POWER_AWAKE_AFTER_BOOT_MIN
    int "Stay awake after a power-on or reset (minutes)"
    depends on POWER_DEEP_SLEEP
    range 0 120
    default 10

config POWER_AWAKE_AFTER_ACTIVITY_MIN
    int "Stay awake after a serial command (minutes)"
    depends on POWER_DEEP_SLEEP
    range 0 120
    default 5

config POWER_MIN_SLEEP_S
    int "Shortest deep sleep (seconds)"
    depends on POWER_DEEP_SLEEP
    range 10 3600
    default 60
    help
        If the next cycle is due sooner, the hub waits awake.

config POWER_MAX_SLEEP_MIN
    int "Longest deep sleep (minutes)"
    depends on POWER_DEEP_SLEEP
    range 10 1440
    default 720
    help
        The hub wakes up at least this often, even with nothing scheduled,
        and goes back to sleep after checking its schedule.

endmenu
```

## components/sd_log/Kconfig
```kconfig
menu "TrailCamHub: log on the SD card"
    depends on SD_CARD_ENABLE

config SD_LOG_ENABLE
    bool "Write the log to the SD card"
    default y
    help
        Copy every log line to /sdcard/logs/log-NNNNN.txt, so that a test
        run can be read afterwards (or live in the web UI) without a serial
        console. The lines are written every SD_LOG_FLUSH_INTERVAL_S seconds
        and synced to the card. A new file is started at every boot (but not
        at a wake-up from deep sleep, which continues the last file) and
        when a file reaches the size limit; the oldest files are removed.

config SD_LOG_FLUSH_INTERVAL_S
    int "Write interval (seconds)"
    depends on SD_LOG_ENABLE
    range 1 60
    default 10 if HUB_PROFILE_AUTONOMOUS
    default 1
    help
        Fewer, larger writes save power and wear of the card; pulling the
        card loses the lines of up to one interval. The log is written in
        full before the hub goes to sleep.

config SD_LOG_MAX_FILE_KB
    int "Maximum size of one log file (KB)"
    depends on SD_LOG_ENABLE
    range 64 65536
    default 4096

config SD_LOG_MAX_FILES
    int "Log files to keep"
    depends on SD_LOG_ENABLE
    range 2 1000
    default 50

config SD_LOG_BUFFER_KB
    int "Log buffer in PSRAM (KB)"
    depends on SD_LOG_ENABLE
    range 8 1024
    default 64
    help
        Holds the lines until they are written, including the boot messages
        before the card is mounted. Without PSRAM an 8 KB buffer in internal
        RAM is used.

config SD_LOG_CYCLES_MAX_KB
    int "Size limit of the cycle journal (KB)"
    depends on SD_LOG_ENABLE
    range 16 4096
    default 256
    help
        /sdcard/logs/cycles.jsonl gets one line per cycle (about 300 bytes:
        start, kind, result, duration, lowest free heap and stack). When it
        reaches this size it becomes cycles.1.jsonl, replacing the previous
        one, and a new file starts.

endmenu
```
