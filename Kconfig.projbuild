## components/sd_storage/Kconfig
```kconfig
menu "TrailCamHub: SD card"

config SD_CARD_ENABLE
    bool "Mount the SD card at boot"
    default y
    help
        Mount the FAT file system of the microSD card at /sdcard using the
        SDMMC peripheral or, in SPI mode, an SPI bus. The card is never
        formatted automatically. On the ESP32-S3 boards the card is used in
        1-bit SDMMC mode on the GPIOs below; on the ESP32-P4-NANO it uses
        SDMMC slot 0 in 4-bit mode on its fixed IO MUX pins (CLK GPIO43, CMD
        GPIO44, D0-D3 GPIO39-42), powered by on-chip LDO channel 4. In SPI
        mode CLK is the SPI clock, CMD the MOSI and D0 the MISO line.

config SD_CARD_SPI_MODE
    bool "Use the card in SPI mode" if SOC_SDMMC_HOST_SUPPORTED
    depends on SD_CARD_ENABLE && !IDF_TARGET_ESP32P4
    default y if !SOC_SDMMC_HOST_SUPPORTED
    help
        Talk to the card over SPI2 instead of SDMMC. Required on chips
        without an SDMMC host (ESP32-C5). The bus may be shared with other
        devices such as a display.

config SD_CARD_CLK_GPIO
    int "CLK GPIO"
    depends on SD_CARD_ENABLE && !IDF_TARGET_ESP32P4
    range 0 48
    default 5

config SD_CARD_CMD_GPIO
    int "CMD GPIO"
    depends on SD_CARD_ENABLE && !IDF_TARGET_ESP32P4
    range 0 48
    default 4

config SD_CARD_D0_GPIO
    int "D0 GPIO"
    depends on SD_CARD_ENABLE && !IDF_TARGET_ESP32P4
    range 0 48
    default 6

config SD_CARD_CS_GPIO
    int "CS GPIO"
    depends on SD_CARD_SPI_MODE
    range 0 48
    default 23

config SD_CARD_LDO_CHANNEL
    int "On-chip LDO channel powering the card"
    depends on SD_CARD_ENABLE && IDF_TARGET_ESP32P4
    range 1 4
    default 4

endmenu
```

## components/session_controller/Kconfig
```kconfig
menu "TrailCamHub: session"

config SESSION_BLE_ACTIVATION_TIMEOUT_S
    int "Camera BLE activation timeout (seconds)"
    range 10 600
    default 90
    help
        Time allowed for finding the camera over BLE and receiving its Wi-Fi
        credentials after a scan was requested. A timeout counts as a failed
        attempt.

config SESSION_WIFI_JOIN_TIMEOUT_S
    int "Wi-Fi join timeout (seconds)"
    range 5 300
    default 30
    help
        Time allowed for joining the camera access point after the camera
        returned its Wi-Fi credentials, and for joining the home Wi-Fi for
        the backend uplink.

config SESSION_MAX_ATTEMPTS
    int "Attempts per camera"
    range 1 10
    default 3
    help
        A scan activates a camera at most this many times before giving up
        on it. A camera that answered over BLE but could not be read is then
        skipped and the scan goes on with the next one; if no camera was
        read, the hub returns to idle and the next scan comes with the next
        request or the schedule, which waits longer after failed scans.

config SESSION_MAX_CAMERAS
    int "Cameras per scan"
    range 1 4
    default 4
    help
        A scan reads one camera after the other: after each one it looks for
        a further camera over BLE, skipping those done in this scan, until
        none answers within SESSION_NEXT_CAMERA_TIMEOUT_S or this many are
        done. Then it syncs all of them in one check-in. With 1 a scan reads
        only the first camera that answers and spends no time looking for
        more.

config SESSION_NEXT_CAMERA_TIMEOUT_S
    int "Time to look for a further camera (seconds)"
    range 5 300
    default 20
    help
        After a camera is done, the scan looks this long for a further one
        over BLE. Each scan spends this time once after its last camera, so
        keep it short on battery; a camera is usually found within a few
        seconds when it is awake.

config SESSION_CAMERA_BUDGET_S
    int "Time budget for the cameras of one scan (seconds)"
    range 0 7200
    default 900
    help
        No further camera is started once the camera part of a scan has run
        this long; the cameras read so far are synced, the others wait for
        the next scan. A running camera session is not cut short. 0: no
        limit.

config SESSION_RETRY_DELAY_S
    int "Delay between camera attempts (seconds)"
    range 1 600
    default 10

endmenu
```

## components/time_sync/Kconfig
```kconfig
menu "TrailCamHub: clock"

config TIME_ZONE
    string "Time zone (POSIX TZ rule)"
    default "CET-1CEST,M3.5.0,M10.5.0/3"
    help
        The time zone of the device, as the TZ rule of the C library: the name
        of the standard time and its offset from UTC (west of Greenwich
        positive, so "CET-1" is one hour east), then the summer time with the
        dates on which it starts and ends. The default is Central European
        Time and Summer Time. Rules for other zones: the TZ column of
        https://github.com/nayarsystems/posix_tz_db/blob/master/zones.csv
        The camera sets its clock at login. The TrailCam Go app gives it the
        local time of the phone, and the camera shows that time on its photos
        and videos as it is, so the device sends its local time too. Without
        a valid clock the login carries no time and the camera keeps its own.

config TIME_SYNC_SNTP
    bool "Set the clock by SNTP"
    default y
    help
        The clock is not set at boot. Without it, the time of a camera sync
        and the file times are not recorded, and the camera login carries no
        time, so the camera keeps its own clock. With this option the device asks an NTP server as soon as
        a network with internet access is up (Ethernet, or the home Wi-Fi
        during a backend sync) and then about once an hour. The backend sync
        sets the clock as well. Traffic goes to the server below only.

config TIME_SYNC_SERVER
    string "NTP server"
    depends on TIME_SYNC_SNTP
    default "pool.ntp.org"

config TIME_SYNC_BROWSER
    bool "Take the time of a browser that opens the web UI"
    depends on WEB_UI_ENABLE
    default y
    help
        The page sends the time of the computer or phone that shows it, when
        the clock of the device comes from no better source than that (SNTP
        or the backend replace it, and it replaces the camera's time). The
        camera gets it with the next login. Anyone who can reach the web UI
        can set the clock this way.

config TIME_SYNC_CAMERA
    bool "Take the time of the camera if there is no other"
    default y
    help
        When a session starts while the clock holds no time, the device takes
        the time that the camera reports (the clock it was last given, shown
        as local time and turned back to UTC with TIME_ZONE) and does not give
        it back to the camera. A time before the build of the firmware is not
        taken, but a camera clock that someone set wrong is: any other source
        replaces it.

endmenu
```

## components/uplink/Kconfig
```kconfig
menu "TrailCamHub: uplink"

config UPLINK_VIDEO_MAX_MB
    int "Largest video uploaded to the backend (MB)"
    depends on CAMERA_DOWNLOAD_VIDEOS
    range 1 1000
    default 50
    help
        Requested videos are uploaded as MP4, built while they are sent from
        the stored H.264 and AAC files (nothing extra is stored). A larger
        one is reported as failed.

config UPLINK_VIDEO_MAX_MB_MODEM
    int "Largest video uploaded over the cellular modem (MB)"
    depends on CAMERA_DOWNLOAD_VIDEOS && MODEM_UPLINK
    range 1 1000
    default 15
    help
        A lower limit when the hub syncs over the A7670E (setting
        "transport"): data volume and radio time. Measured with LTE Cat-1:
        about 650 KB of MP4 per second of 1080p video and about 50 KB/s
        upload, so 15 MB is a clip of ~20 s and ~5 min of transmitting. A
        larger video is answered as failed with the reason; a hub syncs
        over one transport only, so it is not kept for a Wi-Fi sync.

endmenu
```

## components/web_ui/Kconfig
```kconfig
menu "TrailCamHub: web UI"

config WEB_UI_ENABLE
    bool "Serve a web UI"
    depends on !IDF_TARGET_ESP32P4 || ETH_UPLINK_ENABLE
    default n
    help
        Serve a web UI to start and stop the camera search, follow the
        status and the live log, and browse, view and download the files on
        the SD card. Boards with Wi-Fi only open their own WPA2 access point
        "TrailCamHub-XXXX" next to the camera station and serve it at
        http://10.42.0.1; while the camera Wi-Fi is joined, the access point
        uses the camera's channel, so clients are disconnected briefly when
        it changes. Needs about 40 KB of internal RAM. The ESP32-P4 serves
        it over its Ethernet port instead (see WEB_UI_OVER_ETHERNET).

config WEB_UI_OVER_ETHERNET
    bool
    depends on WEB_UI_ENABLE && ETH_UPLINK_ENABLE
    default y
    help
        Serve the web UI on the Ethernet interface at the address that the
        DHCP server of the network assigns, without an access point. The
        address is shown in the log ("Web UI at http://..."). The page asks
        for a password (HTTP Basic auth, any user name; see
        WEB_UI_ETHERNET_PASSWORD), which the log shows next to the address.
        HTTP is not encrypted: use it in a network you trust.

config WEB_UI_ETHERNET_PASSWORD
    string "Web UI password over Ethernet (empty: generate one)"
    depends on WEB_UI_OVER_ETHERNET
    default ""
    help
        At least 8 characters. When empty, a random password is generated
        at the first boot, stored in NVS and shown in the boot log with the
        address of the page.

config WEB_UI_AP_PASSWORD
    string "Access point password (empty: generate one)"
    depends on WEB_UI_ENABLE && !WEB_UI_OVER_ETHERNET
    default ""
    help
        At least 8 characters. When empty, a random password is generated
        at the first boot, stored in NVS and shown on the dongle display.

endmenu
```

## main/Kconfig.projbuild
```kconfig
# Board and preset of the build. The options of the other parts are in the
# Kconfig file of their component (menuconfig: Component config ->
# "TrailCamHub: ..."); docs/modes.md lists where each setting lives.
menu "TrailCamHub"

choice HUB_PROFILE
    prompt "Preset mode"
    default HUB_PROFILE_ON_SITE if BOARD_TDONGLE || IDF_TARGET_ESP32P4 || BOARD_S3_ETH || BOARD_ESP32_WROOM32D
    default HUB_PROFILE_AUTONOMOUS
    help
        The board's build sets what the hub can do (modem, Ethernet, battery
        gauge, web UI, display); how it is used is chosen at run time with
        the settings "power" (mains or battery) and "direction" (push or
        pull), stored in NVS (console "config set", web installer). This
        preset is the mode of a hub whose settings leave them empty. See
        docs/modes.md and docs/power-and-schedule.md.

config HUB_PROFILE_AUTONOMOUS
    bool "Battery + push (no one on site)"
    help
        Reads the cameras on a schedule, pushes to its destination (the
        backend) and sleeps (deep sleep) in between. After a power-on or
        reset the hub stays awake for a few minutes for the web installer
        and the serial console. Preset of the Waveshare
        ESP32-S3-A7670E-4G.

config HUB_PROFILE_ON_SITE
    bool "Mains + pull (person present, permanent power)"
    help
        Stays awake and waits for the button, the web UI or the serial
        console; no automatic reads or check-ins unless a schedule is set or
        the hub pushes to a configured destination. Preset of the T-Dongles
        and the ESP32-P4-NANO. Without a web UI in the build, the direction
        is push.

endchoice

config BOARD_TDONGLE_S3
    bool "LilyGO T-Dongle-S3 display and button"
    depends on IDF_TARGET_ESP32S3
    default n
    help
        Show the camera workflow status on the 0.96" display and use the
        button on the back (GPIO0) to search for the camera. Selected by
        sdkconfig.defaults.tdongle-s3.

config BOARD_TDONGLE_C5
    bool "LilyGO T-Dongle-C5 display and button"
    depends on IDF_TARGET_ESP32C5
    default n
    help
        Show the camera workflow status on the 0.96" display and use the
        button (GPIO28) to search for the camera. The display shares its
        SPI bus with the microSD card. Selected by
        sdkconfig.defaults.tdongle-c5.

config BOARD_S3_ETH
    bool "Waveshare ESP32-S3-ETH (W5500 Ethernet)"
    depends on IDF_TARGET_ESP32S3
    default n
    help
        Ethernet over the board's W5500, microSD in SPI mode, console on the
        native USB port; no modem and no battery gauge. Selected by
        sdkconfig.defaults.s3-eth.

config BOARD_ESP32_WROOM32D
    bool "ESP32-WROOM-32D with an SPI microSD reader"
    depends on IDF_TARGET_ESP32
    default n
    help
        Classic ESP32 dev board (4 MB flash, no PSRAM) with an external
        microSD breakout in SPI mode; console on UART0 through the board's
        USB-to-UART bridge. Mains power only. Selected by
        sdkconfig.defaults.wroom32d (#77).

config BOARD_TDONGLE
    bool
    default y if BOARD_TDONGLE_S3 || BOARD_TDONGLE_C5

endmenu
```
