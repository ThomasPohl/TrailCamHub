## components/boot_button/Kconfig
```kconfig
menu "TrailCamHub: BOOT button"

config HUB_BOOT_BUTTON
    bool "Use the BOOT button as the \"fetch now\" button"
    default y if IDF_TARGET_ESP32 || (IDF_TARGET_ESP32S3 && !BOARD_TDONGLE)
    default n
    help
        A short press searches for the cameras now (as the console's
        "scan"), a long press stops the search. With deep sleep the button
        also wakes the hub, which then reads the cameras at once. Needs no
        extra hardware: the BOOT button of the board is on GPIO0.

        GPIO0 is a strapping pin. Holding the button while the chip is reset
        or powered on starts the serial bootloader (flashing mode), so do not
        keep it pressed when pressing reset or connecting power.

        Off on the T-Dongles, whose button belongs to the dongle display
        (dongle_ui), and on the ESP32-P4-NANO.

config HUB_BUTTON_GPIO
    int "Button GPIO"
    depends on HUB_BOOT_BUTTON
    range 0 39
    default 0
    help
        The button pulls this pin to ground. To wake the hub from deep sleep
        it has to be an RTC-capable pin (GPIO0 to 21 on the ESP32-S3,
        0/2/4/12-15/25-27/32-39 on the ESP32).

config HUB_BUTTON_LONG_PRESS_MS
    int "Long press (milliseconds)"
    depends on HUB_BOOT_BUTTON
    range 500 5000
    default 1500

endmenu
```

## components/oled_ui/Kconfig
```kconfig
menu "TrailCamHub: OLED display"

config HUB_OLED
    bool "Show the status on an SSD1306 OLED (128x64, I2C)"
    depends on !BOARD_TDONGLE
    default n
    help
        An optional display for boards without one (#224). It shows the
        screens of the T-Dongle's display (search, connecting, result, retry)
        in monochrome.

config HUB_OLED_I2C_ADDRESS
    hex "I2C address"
    depends on HUB_OLED
    range 0x3c 0x3d
    default 0x3c

config HUB_OLED_SHARE_BATTERY_BUS
    bool "Use the battery gauge's I2C bus"
    depends on HUB_OLED && HUB_BATTERY_MAX17048
    default y
    help
        On the Waveshare ESP32-S3-A7670E-4G the OLED shares the bus of the
        MAX17048 (address 0x36; the OLED is 0x3C). Turn this off to give the
        OLED a bus of its own on the pins below.

config HUB_OLED_I2C_SDA_GPIO
    int "I2C SDA GPIO (own bus)"
    depends on HUB_OLED && !HUB_OLED_SHARE_BATTERY_BUS
    default 21

config HUB_OLED_I2C_SCL_GPIO
    int "I2C SCL GPIO (own bus)"
    depends on HUB_OLED && !HUB_OLED_SHARE_BATTERY_BUS
    default 22

endmenu
```

## components/schedule_state/Kconfig
```kconfig
menu "TrailCamHub: schedule"

config SCHEDULE_CAMERA_PLAN
    string "Camera read plan"
    default "*=120"
    help
        Applies on battery power, or when the hub pushes to a configured
        destination; otherwise (mains, nothing to push to) there are no
        automatic reads unless camera_plan is set.
        When the hub reads the cameras on its own: time windows in local time
        (TIME_ZONE), each with an interval in minutes, and "*" for the rest
        of the day, for example
          05:00-09:00=30,17:00-22:00=30,*=120
        reads every 30 minutes at dawn and dusk and every two hours
        otherwise. An interval of 0 means no reads; an empty plan or "off"
        means no automatic reads at all. The first window that contains a
        time applies. Without a valid clock the windows are ignored and the
        "*" interval applies (if it is 0 or missing, the longest window
        interval). Each read wakes the camera's Wi-Fi for a minute or two,
        which costs its battery. A read is followed by a backend sync if the
        uplink is configured.
        Overridden by "config set camera_plan" (serial console, web
        installer) and by the backend.

config SCHEDULE_QUIET
    string "Quiet hours (local time)"
    default "23:00-06:00"
    help
        Applies on battery power; on mains there are no quiet hours unless
        "quiet" is set. A time window "HH:MM-HH:MM" in local time
        (TIME_ZONE), which may span midnight. Inside it the hub neither
        reads the cameras nor checks in and sleeps until the end; what was
        due waits and runs at the end (a read, which also syncs). A read
        asked for by the app waits as well. The BOOT button and a power-on
        still start a cycle. "off" or an empty text: no quiet hours. Needs
        a valid clock, otherwise it is ignored.
        Overridden by "config set quiet".

config SCHEDULE_LOCATION
    string "Location of the hub (LAT,LON in decimal degrees)"
    default ""
    help
        For the sun times of read windows such as
        "sunrise-60..sunrise+90=30" in the camera plan, for example
        "52.5,13.4" (rounded to 0.1 degrees, about 10 km). Empty: the
        hub uses the middle of Germany (51.0,10.0), which is off by up to
        about 25 minutes at the borders, and tells it in "status".
        Overridden by "config set location".

config SCHEDULE_ENERGY
    bool "Check in more often when the battery history allows it"
    default y
    help
        The hub keeps the charge of its cell in the morning and how long the
        cell sat full while charging for the last seven days (needs the
        battery gauge). A cell that is well charged in the morning with a
        steady trend shortens the check-in interval in steps (x0.75, x0.5);
        a low morning or a falling trend take it back. A full cell halves it
        at once for the rest of the day. Camera reads are not affected.
        Not at a low or critical hub battery. See docs/power-and-schedule.md.

config SCHEDULE_ENERGY_TARGET_PERCENT
    int "Charge the cell should have in the morning (%)"
    depends on SCHEDULE_ENERGY
    range 20 90
    default 60

config SCHEDULE_MIN_INTERVAL_MIN
    int "Shortest check-in interval with the energy factor (minutes)"
    depends on SCHEDULE_ENERGY
    range 5 120
    default 10

config SCHEDULE_CHECKIN_INTERVAL_MIN
    int "Backend check-in interval (minutes, 0 = off)"
    range 0 1440
    default 30
    help
        Applies when the hub pushes (direction push); with pull there are no
        check-ins.
        How often the hub syncs with the backend between camera reads, to
        pick up commands from the app (for example a camera read on
        request) and upload what is left. Only with complete uplink
        settings; every camera read syncs as well and restarts the
        interval. Overridden by "config set checkin_min" and by the
        backend.

config SCHEDULE_START_DELAY_S
    int "Delay before the first scheduled cycle after power-on (seconds)"
    range 0 3600
    default 60
    help
        Gives the web installer and the serial console time before the
        first automatic camera read or check-in after a power-on or reset.
        Not applied after a wake-up from deep sleep.

config SCHEDULE_LOW_BATTERY_PERCENT
    int "Camera battery level that stretches the read interval (%, 0 = off)"
    range 0 100
    default 20

config SCHEDULE_LOW_BATTERY_FACTOR
    int "Read interval factor for a camera with a low battery"
    range 1 16
    default 3
    help
        Failed reads stretch the interval as well (2, 4, 8, 16 times after
        one to four failures in a row), and failed check-ins stretch the
        check-in interval in the same way, up to one day.

endmenu
```

## tools/camera_mock/main/Kconfig.projbuild
```kconfig
menu "Camera mock"

config CAMERA_MOCK_AP_PASSWORD
    string "Wi-Fi password of the mock's access point"
    default "12345678"
    help
        WPA2 password (8-63 characters) that the mock hands out over BLE,
        like the camera's 8-digit password.

config CAMERA_MOCK_DEV_ID
    string "Camera MAC (devId)"
    default "C6:1E:0D:E0:0C:FB"
    help
        The camera's identity: devId in the device info (512), the MAC in
        the BLE advertising and the media headers; the BLE name is TC100_
        and the last two bytes. Default: the captured TC100. Give a second
        mock another MAC to stand for a second camera. The console command
        `id <MAC>` overrides it (stored in NVS).

config CAMERA_MOCK_MEDIA_COUNT
    int "Recordings in the media list"
    range 0 1000
    default 90
    help
        90 is the captured list of a real TC100, byte for byte. Fewer
        entries cut it; more continue the numbering with invented entries
        (photo and video alternate). 0 is an empty card. The console
        command `media <N>` changes it until the next reset.

config CAMERA_MOCK_AP_CHANNEL
    int "Wi-Fi channel of the access point"
    range 1 13
    default 6

config CAMERA_MOCK_AP_ALWAYS_ON
    bool "Start the access point at boot"
    default n
    help
        The camera turns its Wi-Fi on only after the BLE wake-up. With this
        option the mock's access point is up from the start (the hub still
        has to read the credentials over BLE).

endmenu
```
